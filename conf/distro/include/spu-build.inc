## conf/distro/include/spu-build.inc
```bitbake
# Shared STEP-SPU Yocto build policy.
# Include this from local.conf to avoid hardcoding build policy in setup scripts.

DISTRO_FEATURES:append = " systemd"
VIRTUAL-RUNTIME_init_manager = "systemd"

INHERIT += "mender-full"
MENDER_ARTIFACT_NAME ?= "step-spu-release-1.0.0"
MENDER_STORAGE_DEVICE ?= "/dev/mmcblk0"
MENDER_BOOT_PART_SIZE_MB ?= "256"
MENDER_DATA_PART_SIZE_MB ?= "512"

SPU_USER ?= "spu-user"
SPU_INSTALL_DIR ?= "/home/${SPU_USER}/step-spu"
SPU_WIFI_SSID ?= "ChangeSSID"
SPU_WIFI_PSK ?= ""
SPU_HOSTNAME ?= "cvip-spu"
SPU_MENDER_SERVER_URL ?= "https://mender.example.com"

BB_NUMBER_THREADS ?= "4"
PARALLEL_MAKE ?= "-j4"
```

## conf/distro/include/spu-workarounds.inc
```bitbake
# Work around binutils gold linker build failures on this toolchain.
LDGOLD:pn-binutils = ""

# Disable SPDX task generation; native sstate may not include SPDX artifacts.
INHERIT_DISTRO:remove = "create-spdx"
INHERIT:remove = "create-spdx"
```

## conf/distro/include/step-spu.conf
```bitbake
DISTRO_FEATURES:append = " x11 opengl"
DISTRO_FEATURES:remove = " wayland"

SPU_USER ?= "spu-user"
```

## conf/layer.conf
```bitbake
# We have a conf and classes directory, add to BBPATH
BBPATH .= ":${LAYERDIR}"

# SPU layer configuration
DISTRO_FEATURES:append = " x11 opengl webengine dbus"
DISTRO_FEATURES:remove = " wayland ptest"

MACHINE_FEATURES:append = " wifi touchscreen"
SPLASH = "plymouth"

SPU_USER ?= "spu-user"

# We have recipes-* directories, add to BBFILES
BBFILES += "${LAYERDIR}/recipes-*/*/*.bb \
            ${LAYERDIR}/recipes-*/*/*.bbappend"

BBFILE_COLLECTIONS += "meta-spu"
BBFILE_PATTERN_meta-spu = "^${LAYERDIR}/"
BBFILE_PRIORITY_meta-spu = "100"


LAYERDEPENDS_meta-spu = "core"
LAYERVERSION_meta-spu = "1"

LAYERSERIES_COMPAT_meta-spu = "scarthgap"
```

## conf/machine/include/spu-raspberrypi.inc
```bitbake
RPI_USE_U_BOOT:rpi = "1"
ENABLE_I2C:rpi = "1"
KERNEL_MODULE_AUTOLOAD:rpi += " i2c-dev "
RPI_EXTRA_CONFIG:append = "\ndisplay_auto_detect=1\n"
RPI_EXTRA_CONFIG:append = "\nusb_max_current_enable=1"
RPI_EXTRA_CONFIG:append = "\ndtoverlay=vc4-kms-dsi-ili9881-7inch,rotation=270"
```

## conf/machine/spu-rpi5.conf
```bitbake
MACHINEOVERRIDES =. "raspberrypi5:"

require conf/machine/raspberrypi5.conf
require conf/machine/include/spu-raspberrypi.inc
```
